## rx/sdkconfig.defaults
```kconfig
# ESP32-S3 BLE MIDI Receiver SDK Configuration

# Target
CONFIG_IDF_TARGET="esp32s3"

# USB Device (TinyUSB)
CONFIG_TINYUSB_ENABLED=y
CONFIG_TINYUSB_MIDI_ENABLED=y
CONFIG_TINYUSB_DESC_BOS_ENABLED=y

# TinyUSB缓冲区
CONFIG_TINYUSB_MIDI_FIFO_SIZE=128

# Bluetooth
CONFIG_BT_ENABLED=y
CONFIG_BT_NIMBLE_ENABLED=n
CONFIG_BT_BLUEDROID_ENABLED=y
CONFIG_BT_BLE_ENABLED=y
CONFIG_BT_CLASSIC_ENABLED=n

# BLE GATTC
CONFIG_BT_GATTC_ENABLE=y
CONFIG_BT_GATTC_CACHE_NVS_FLASH=n
CONFIG_BT_GATTC_CONNECT_RETRY_COUNT=3

# BLE优化
CONFIG_BT_BLE_42_FEATURES_SUPPORTED=y
CONFIG_BT_BLE_50_FEATURES_SUPPORTED=n
CONFIG_BTDM_CTRL_MODE_BLE_ONLY=y
CONFIG_BT_CTRL_BLE_MAX_ACT=6

# 内存优化
CONFIG_BT_BLE_DYNAMIC_ENV_MEMORY=y

# 日志级别
CONFIG_LOG_DEFAULT_LEVEL_INFO=y
CONFIG_LOG_DEFAULT_LEVEL=3

# LED Strip RMT
CONFIG_RMT_ISR_IRAM_SAFE=n

# 任务看门狗
CONFIG_ESP_TASK_WDT_TIMEOUT_S=10

# Flash
CONFIG_ESPTOOLPY_FLASHSIZE_4MB=y
CONFIG_ESPTOOLPY_FLASHSIZE="4MB"

# 分区表
CONFIG_PARTITION_TABLE_SINGLE_APP=y
```

## tx/sdkconfig.defaults
```kconfig
# ESP32-S3 BLE MIDI Transmitter SDK Configuration

# Target
CONFIG_IDF_TARGET="esp32s3"

# USB Host
CONFIG_USB_HOST_CONTROL_TRANSFER_MAX_SIZE=1024
CONFIG_USB_HOST_HW_BUFFER_BIAS_BALANCED=y

# Bluetooth
CONFIG_BT_ENABLED=y
CONFIG_BT_NIMBLE_ENABLED=n
CONFIG_BT_BLUEDROID_ENABLED=y
CONFIG_BT_BLE_ENABLED=y
CONFIG_BT_CLASSIC_ENABLED=n

# BLE优化
CONFIG_BT_BLE_42_FEATURES_SUPPORTED=y
CONFIG_BT_BLE_50_FEATURES_SUPPORTED=n
CONFIG_BTDM_CTRL_MODE_BLE_ONLY=y
CONFIG_BT_CTRL_BLE_MAX_ACT=6
CONFIG_BT_BLE_GAP_ADV_EXT_ENABLE=n

# 内存优化
CONFIG_BT_BLE_DYNAMIC_ENV_MEMORY=y

# GATT配置
CONFIG_BT_GATT_MAX_SR_PROFILES=4
CONFIG_BT_GATT_MAX_SR_ATTRIBUTES=32

# 日志级别
CONFIG_LOG_DEFAULT_LEVEL_INFO=y
CONFIG_LOG_DEFAULT_LEVEL=3

# LED Strip RMT
CONFIG_RMT_ISR_IRAM_SAFE=n

# 任务看门狗
CONFIG_ESP_TASK_WDT_TIMEOUT_S=10

# Flash
CONFIG_ESPTOOLPY_FLASHSIZE_4MB=y
CONFIG_ESPTOOLPY_FLASHSIZE="4MB"

# 分区表
CONFIG_PARTITION_TABLE_SINGLE_APP=y
```
